## main/Kconfig.projbuild
```kconfig
menu "Example Configuration"

    config EXAMPLE_WIFI_SSID
        string "WiFi SSID"
        default "myssid"
        help
            SSID (network name) for the example to connect to.
            Only 2.4 GHz band is supported (ESP32-C6 limitation).

    config EXAMPLE_WIFI_PASSWORD
        string "WiFi Password"
        default "mypassword"
        help
            Password for the target WiFi network.

    config CAMERA_HTTP_ENABLED
        bool "Enable HTTP Camera Fetch (ESP32-CAM relay)"
        default n
        help
            [已弃用] 当前架构下 Docker 直连 ESP32-CAM HTTP 拉流，不再需要 P4 UDP 中继。
            如需恢复旧方案 (P4 中继转发)，开启此项。

    config CAMERA_HTTP_ESP32CAM_URL
        string "ESP32-CAM HTTP Capture URL"
        default "http://10.16.234.23/capture"
        help
            Full URL to the ESP32-CAM's single JPEG capture endpoint.
            Typically http://<esp32cam-ip>/capture for Arduino CameraWebServer.

    config CAMERA_HTTP_UDP_IP
        string "Camera UDP Target IP (PC)"
        default "10.16.234.215"
        help
            Destination IP address for JPEG stream forwarding (UDP port 8082).
            Should match the PC running camera_display_receiver.py.

    config CAMERA_HTTP_FPS
        int "Camera Fetch Rate (FPS)"
        range 1 10
        default 10
        help
            Target frame fetch rate from ESP32-CAM.
            Lower values reduce bandwidth. ESP32-CAM typically 3-5 fps.

endmenu
```

## psram_test/sdkconfig.defaults
```kconfig
CONFIG_IDF_TARGET="esp32p4"
CONFIG_ESPTOOLPY_FLASHMODE_QIO=y
CONFIG_ESPTOOLPY_FLASHSIZE_16MB=y
CONFIG_COMPILER_OPTIMIZATION_PERF=y
CONFIG_SPIRAM=y
CONFIG_SPIRAM_MODE_HEX=y
CONFIG_SPIRAM_SPEED_80M=y
CONFIG_SPIRAM_BOOT_HW_INIT=y
CONFIG_SPIRAM_BOOT_INIT=y
CONFIG_SPIRAM_MEMTEST=y
CONFIG_SPIRAM_USE_MALLOC=y
CONFIG_SPIRAM_MALLOC_ALWAYSINTERNAL=1024
# CONFIG_SPIRAM_ALLOW_BSS_SEG_EXTERNAL_MEMORY is not set
CONFIG_ESP_MAIN_TASK_STACK_SIZE=8192
CONFIG_CACHE_L2_CACHE_256KB=y
CONFIG_CACHE_L2_CACHE_LINE_128B=y
```
